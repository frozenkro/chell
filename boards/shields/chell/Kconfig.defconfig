## boards/shields/chell/Kconfig.defconfig
```kconfig
if SHIELD_chell_RIGHT

config ZMK_KEYBOARD_NAME
    default "chell"

config ZMK_SPLIT_ROLE_CENTRAL
    default y

endif # SHIELD_chell_RIGHT

if SHIELD_chell_LEFT || SHIELD_chell_RIGHT

config ZMK_SPLIT
    default y

endif # SHIELD_chell_LEFT || SHIELD_chell_RIGHT
```

## boards/shields/chell/Kconfig.shield
```kconfig
config SHIELD_chell_LEFT
    def_bool $(shields_list_contains,chell_left)

config SHIELD_chell_RIGHT
    def_bool $(shields_list_contains,chell_right)
```

## boards/shields/cosmotyl/Kconfig.defconfig
```kconfig
if SHIELD_cosmotyl_RIGHT

config ZMK_KEYBOARD_NAME
    default "cosmotyl"

config ZMK_SPLIT_ROLE_CENTRAL
    default y

endif # SHIELD_cosmotyl_RIGHT

if SHIELD_cosmotyl_LEFT || SHIELD_cosmotyl_RIGHT

config ZMK_SPLIT
    default y

endif # SHIELD_cosmotyl_LEFT || SHIELD_cosmotyl_RIGHT
```
